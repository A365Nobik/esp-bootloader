## sdkconfig.defaults
```kconfig
CONFIG_BOOTLOADER_FACTORY_RESET=y
# Your boot pin
CONFIG_BOOTLOADER_NUM_PIN_FACTORY_RESET=41
CONFIG_BOOTLOADER_FACTORY_RESET_PIN_LOW=y
CONFIG_BOOTLOADER_HOLD_TIME_GPIO=2
CONFIG_PARTITION_TABLE_CUSTOM=y
CONFIG_BOOTLOADER_OTA_DATA_ERASE=y
CONFIG_BOOTLOADER_DATA_FACTORY_RESET="nvs"

CONFIG_PARTITION_TABLE_CUSTOM_FILENAME="partitions.csv"
CONFIG_PARTITION_TABLE_OFFSET=0x8000
CONFIG_PARTITION_TABLE_MD5=y
```

## targets/esp32s2/sdkconfig.defaults
```kconfig
#ESP32-S2 SDK

CONFIG_BOOTLOADER_FACTORY_RESET=y
# Your boot pin
CONFIG_BOOTLOADER_NUM_PIN_FACTORY_RESET=41
CONFIG_BOOTLOADER_FACTORY_RESET_PIN_LOW=y
CONFIG_BOOTLOADER_HOLD_TIME_GPIO=2
CONFIG_PARTITION_TABLE_CUSTOM=y
CONFIG_BOOTLOADER_OTA_DATA_ERASE=y
CONFIG_BOOTLOADER_DATA_FACTORY_RESET="nvs"

CONFIG_PARTITION_TABLE_CUSTOM_FILENAME="partitions.csv"
CONFIG_PARTITION_TABLE_OFFSET=0x8000
CONFIG_PARTITION_TABLE_MD5=y
#Your flash size 4/16 MB
CONFIG_ESPTOOLPY_FLASHSIZE_16MB=y

CONFIG_ESP_MAIN_TASK_STACK_SIZE=8192
```
